## beaglebone/os/configs/bb_example_defconfig
```kconfig
BR2_arm=y
BR2_cortex_a8=y
BR2_CCACHE=y
BR2_TOOLCHAIN_EXTERNAL=y
BR2_TARGET_GENERIC_HOSTNAME="wfe-test"
BR2_TARGET_GENERIC_ISSUE="Hello world! WFE TEST"
BR2_TARGET_GENERIC_ROOT_PASSWD="test"
BR2_LINUX_KERNEL=y
BR2_LINUX_KERNEL_PATCH="5.4.30"
BR2_LINUX_KERNEL_DEFCONFIG="omap2plus"
BR2_LINUX_KERNEL_DTS_SUPPORT=y
BR2_LINUX_KERNEL_INTREE_DTS_NAME="am335x-boneblack-wireless"
BR2_LINUX_KERNEL_NEEDS_HOST_OPENSSL=y
BR2_TARGET_UBOOT=y
BR2_TARGET_UBOOT_BUILD_SYSTEM_KCONFIG=y
BR2_TARGET_UBOOT_CUSTOM_VERSION=y
BR2_TARGET_UBOOT_CUSTOM_VERSION_VALUE="2020.01"
BR2_TARGET_UBOOT_BOARD_DEFCONFIG="am335x_evm"
BR2_TARGET_UBOOT_FORMAT_IMG=y
BR2_TARGET_UBOOT_SPL=y
BR2_TARGET_UBOOT_SPL_NAME="MLO"
BR2_TARGET_UBOOT_CUSTOM_MAKEOPTS="DEVICE_TREE=am335x-boneblack"
```

## package/libopenblt/Config.in
```kconfig
config BR2_PACKAGE_LIBOPENBLT
    bool "libopenblt"
    select BR2_PACKAGE_LIBUSB
    select BR2_PACKAGE_LIBSOCKETCAN
      help
        LibOpenBLT is a host library for the OpenBLT bootloader. Its purpose
        is to allow quick and easy creation of programs that can connect to
        and perform firmware updates on a microcontroller that runs the
        OpenBLT bootloader.

        https://www.feaser.com/openblt/doku.php?id=manual:libopenblt
```
